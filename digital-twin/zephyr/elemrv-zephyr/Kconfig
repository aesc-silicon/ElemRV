## digital-twin/zephyr/elemrv-zephyr/boards/aesc/elemrv_n/Kconfig.defconfig
```kconfig
# SPDX-License-Identifier: Apache-2.0

if BOARD_ELEMRV_N

config BOARD
	default "elemrv_n"

endif # BOARD_ELEMRV_N
```

## digital-twin/zephyr/elemrv-zephyr/boards/aesc/elemrv_n/Kconfig.elemrv_n
```kconfig
# SPDX-License-Identifier: Apache-2.0

config BOARD_ELEMRV_N
	select SOC_ELEMRV_N_VEXRISCV
```

## digital-twin/zephyr/elemrv-zephyr/boards/aesc/elemrv_n/board.yml
```yaml
board:
  name: elemrv_n
  full_name: ElemRV Nitrogen RISC-V SoC
  vendor: aesc
  socs:
    - name: elemrv_n_vexriscv
```

## digital-twin/zephyr/elemrv-zephyr/soc/aesc/elemrv_n_vexriscv/Kconfig
```kconfig
# SPDX-License-Identifier: Apache-2.0

config SOC_ELEMRV_N_VEXRISCV
	select RISCV
	select ATOMIC_OPERATIONS_C
	select INCLUDE_RESET_VECTOR
	select RISCV_ISA_RV32I
	select RISCV_ISA_EXT_M
	select RISCV_ISA_EXT_C
	select RISCV_ISA_EXT_ZICSR
	select RISCV_ISA_EXT_ZIFENCEI
	imply XIP

if SOC_ELEMRV_N_VEXRISCV

config LITEX_CSR_DATA_WIDTH
	int "LiteX CSR data width"
	default 32
	help
	  Width of the LiteX CSR bus registers. ElemRV-N uses 32-bit CSRs.

endif # SOC_ELEMRV_N_VEXRISCV
```

## digital-twin/zephyr/elemrv-zephyr/soc/aesc/elemrv_n_vexriscv/Kconfig.soc
```kconfig
# SPDX-License-Identifier: Apache-2.0

config SOC_ELEMRV_N_VEXRISCV
	bool
	help
	  ElemRV Nitrogen VexRiscv RV32IMC SoC with LiteX-compatible peripherals.

config SOC
	default "elemrv_n_vexriscv" if SOC_ELEMRV_N_VEXRISCV
```

## manifests/west.yml
```yaml
# SPDX-FileCopyrightText: 2026 aesc silicon
#
# SPDX-License-Identifier: CERN-OHL-W-2.0

manifest:
    projects:
      - name: zephyr
        path: modules/elements/zephyr
        url: https://github.com/aesc-silicon/elements-zephyr
        revision: main
        import: true
        import:
          name-allowlist:
            - cmsis
            - hal_riscv
            - picolibc
    self:
      path: .
```
